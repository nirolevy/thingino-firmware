## configs/cameras-exp/besder_w9q_t23n_os02n10_aic8800u/besder_w9q_t23n_os02n10_aic8800u_defconfig
```kconfig
# NAME: Besder W9Q (T23N, 2xOS02N10, AIC8800 USB)
# FRAG: soc-xburst1 toolchain-xburst1 ccache brand rootfs kernel system target uboot ssl
BR2_SOC_INGENIC_T23N=y
FLASH_SIZE_8=y

BR2_ETHERNET=y
BR2_PACKAGE_THINGINO_KOPT_JZ_MAC=y
BR2_PACKAGE_THINGINO_KOPT_JZ_MAC_INTERNAL_PHY=y
BR2_PACKAGE_THINGINO_KOPT_JZ_MAC_V13=y
BR2_PACKAGE_THINGINO_UBOOT_PHY_RESET_AFTER_CONFIG=y
BR2_PACKAGE_THINGINO_UBOOT_GPIO_PHY_RESET=64
BR2_PACKAGE_THINGINO_UBOOT_PATCH="../configs/cameras/jooan_q3r_t23n_sc1a4t_eth+atbm6012bx/patches"

BR2_PACKAGE_WIFI=y
BR2_PACKAGE_WIFI_AIC8800=y
BR2_PACKAGE_WIFI_AIC8800_USB=y
BR2_PACKAGE_WIFI_AIC8800_USB_8800D80=y

# BR2_THINGINO_IMAGE_SENSOR_QTY_2=y
# BR2_SENSOR_1_OS02N10S0=y
# BR2_SENSOR_2_OS02N10S1=y
BR2_SENSOR_OS02N10=y

BR2_PACKAGE_THINGINO_KOPT_MMC0=y
BR2_PACKAGE_THINGINO_KOPT_MMC0_PB_4BIT=y
BR2_THINGINO_SDCARD=y

BR2_THINGINO_AUDIO=y
BR2_THINGINO_BUTTON=y
BR2_THINGINO_PWM_ENABLE=y

BR2_ISP_CONFIG_HZ=200000000
BR2_ISP_CLKA_600MHZ=y
BR2_ISP_DIRECT_MODE_2=y
BR2_PACKAGE_THINGINO_KOPT_I2C=y
BR2_PACKAGE_THINGINO_KOPT_I2C_BUS1=y
```
